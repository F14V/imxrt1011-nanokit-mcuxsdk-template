## CMakeLists.txt
```
cmake_minimum_required(VERSION 3.25.0)

set(CUSTOM_BOARD_ROOT "${CMAKE_CURRENT_LIST_DIR}/boards" CACHE PATH "Custom board root")

# Use the custom board while preserving the SDK-associated EVK for Config Tools.
if(board STREQUAL "evkmimxrt1010")
    set(_config_tools_board "${board}")
    set(board "imxrt1011-nanokit" CACHE STRING "Selected board" FORCE)
endif()

include(${SdkRootDirPath}/cmake/extension/mcux.cmake)

project(imxrt1011-nanokit-mcuxsdk-template LANGUAGES C CXX ASM)

include(${SdkRootDirPath}/CMakeLists.txt)

add_subdirectory(${board})
add_subdirectory(src)

mcux_convert_binary(BINARY ${APPLICATION_BINARY_DIR}/${MCUX_SDK_PROJECT_NAME}.bin)

# Restore the SDK-associated board for Config Tools project matching.
if(DEFINED _config_tools_board)
    set(board "${_config_tools_board}" CACHE STRING "Selected board" FORCE)
endif()
```

## Kconfig
```
# Application defaults must precede the SDK defaults they refine
rsource "${board}/Kconfig"
rsource "${SdkRootDirPath}/Kconfig.mcuxpresso"
```

## prj.conf
```kconfig
# CONFIG.
CONFIG_MCUX_PRJSEG_config.arm.suppress.warn_as_error=y
```

## src/main.c
```c
#include "app.h"

#ifdef SDK_DEBUGCONSOLE
#include "fsl_debug_console.h"
#include "platform/debug_console/app_debug_console.h"
#endif

/*******************************************************************************
 * Definitions
 ******************************************************************************/

/*******************************************************************************
 * Prototypes
 ******************************************************************************/

/*******************************************************************************
 * Code
 ******************************************************************************/

/*!
 * @brief Main function
 */
int main(void)
{
    status_t status;
    (void)status;

    /* Init board hardware */
    BOARD_InitHardware();

#ifdef SDK_DEBUGCONSOLE
    /* Init debug console */
    status = APP_InitDebugConsole();
    if (status != kStatus_Success)
    {
        return -1;
    }

    PRINTF("MCUX SDK version: %s\r\n", MCUXSDK_VERSION_FULL_STR);
#endif

    while (true)
    {
        __WFI();
    }

    return 0;
}
```
